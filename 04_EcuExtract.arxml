AUTOSAR XML (schema 4-3-1)
package /DoorControlECU
  ecu instance DoorControlECU: embedded-sw-composition=DoorControlComposition, ecuextract-version=1.0
    ecu mapping set element DoorControlMapping
    can communication connector CAN_Connector
      comm controller mapping CAN_Controller_Mapping: comm-controller=CanController, physical-channel=CAN_Channel
    can communication controller CanController: controller-id=0, device-type=CAN, can-if-config=can-cluster-config={can-cluster=CAN_Cluster, baudrate=500000}
    pdu-routing-specification:
      pdu routing rule set DoorCommandRoutingRules
        pdu routing rule DoorCommand_RoutingRule: pdu-port=DoorCommand_PDU
        pdu routing rule DoorStatus_RoutingRule: pdu-port=DoorStatus_PDU
package /DoorControlECU/EcuHardware
  4 x hardware element:
    Microcontroller_STM32: hardware-type=MICROCONTROLLER
    CanTransceiver_TJA1040: hardware-type=CAN_TRANSCEIVER
    MotorDriver_DRV88: hardware-type=MOTOR_DRIVER
    PositionSensor_ADC: hardware-type=SENSOR
  4 x io hw abstraction:
    MotorControl_IO: category=DIGITAL_OUTPUT, io-port-name=GPIO_PA0
    MotorDirection_IO: category=DIGITAL_OUTPUT, io-port-name=GPIO_PA1
    PositionSensor_IO: category=ANALOG_INPUT, io-port-name=ADC1_CH0
    CurrentSensor_IO: category=ANALOG_INPUT, io-port-name=ADC1_CH1
package /DoorControlECU/SoftwareComposition
  swc composition DoorControlComposition
    component DoorControlComp: type=DoorControlSWC
    component DiagnosticsComp: type=DiagnosticsSWC
    connect DoorControlComp.DoorStatus_Out -> DiagnosticsComp.DoorStatus_In
package /DoorControlECU/RTE
  rte configuration RTE_Config
    rte-managed-timing:
      timing event DoorControl_10ms: period=0.01
      timing event Diagnostics_50ms: period=0.05
package /DoorControlECU/COM
  com configuration COM_Config
    com i pdu group DoorCommand_Group: com-i-pdu=DoorCommand_PDU
    com i pdu group DoorStatus_Group: com-i-pdu=DoorStatus_PDU
    com-signal-processing:
      com signal route DoorOpenCmd_Route: signal=DoorOpenCmd_Signal
        trigger-interface-mapping:
          interface mapping set DoorOpenCmd_Mapping
package /DoorControlECU/BSW
  autosar BSW_Modules
