AUTOSAR XML (schema 4-3-1)
package /DoorControlSystem/DataTypes
  standard-types:
    uint8 DoorCommandType: category=FIXED_LENGTH
    uint16 DoorPositionType: category=FIXED_LENGTH, native-declaration=uint16 DoorPositionType;
    uint8 DoorStatusType: category=FIXED_LENGTH, native-declaration=uint8 DoorStatusType;
    uint8 DoorErrorType: category=FIXED_LENGTH, native-declaration=uint8 DoorErrorType;
    uint16 SensorPositionType: category=FIXED_LENGTH, native-declaration=uint16 SensorPositionType;
    uint16 CurrentType: category=FIXED_LENGTH, native-declaration=uint16 CurrentType;
    sint8 MotorSpeedType: category=FIXED_LENGTH, native-declaration=sint8 MotorSpeedType;
    uint32 DIDValueType: category=FIXED_LENGTH, native-declaration=uint32 DIDValueType;
  enumeration type DoorStatusEnum: category=FIXED_LENGTH, element-type=uint8
    7 x enumerator:
      DOOR_IDLE: value=0
      DOOR_OPENING: value=1
      DOOR_CLOSING: value=2
      DOOR_OPEN: value=3
      DOOR_CLOSED: value=4
      DOOR_ERROR: value=5
      DOOR_JAMMED: value=6
  enumeration type DoorErrorEnum: category=FIXED_LENGTH, element-type=uint8
    7 x enumerator:
      NO_ERROR: value=0
      OVERCURRENT_ERROR: value=1
      TIMEOUT_ERROR: value=2
      SENSOR_ERROR: value=3
      MOTOR_ERROR: value=4
      CAN_ERROR: value=5
      FAULT_MEMORY: value=6
  enumeration type MotorDirectionEnum: category=FIXED_LENGTH, element-type=sint8
    enumerator MOTOR_STOP: value=0
    enumerator MOTOR_OPEN: value=1
    enumerator MOTOR_CLOSE: value=-1
  structure type DoorStatusStruct: category=FIXED_LENGTH
    4 x structure element:
      Position: type=DoorPositionType
      Status: type=DoorStatusEnum
      Error: type=DoorErrorEnum
      MotorCurrent: type=CurrentType
  structure type DiagnosticDataStruct: category=FIXED_LENGTH
    structure element DIDIdentifier: type=uint16
    structure element DIDValue: type=DIDValueType
    structure element DIDLength: type=uint8
  array type DiagnosticErrorMemory: category=FIXED_LENGTH, element-type=DoorErrorEnum, max-number-of-elements=10
  array type MotorCurrentHistory: category=FIXED_LENGTH, element-type=CurrentType, max-number-of-elements=20
  compumethod DoorPosition_CompuMethod: category=SCALING, unit=Percent, compu-scale{lower-limit=0, upper-limit=10000, compu-rational-scaling=compu-numerator-coefficients=[0, 0.01]}
  compumethod MotorCurrent_CompuMethod: category=SCALING, unit=Milliamp, compu-scale{lower-limit=0, upper-limit=5000, compu-rational-scaling=compu-numerator-coefficients=[0, 1]}
package /DoorControlSystem/Units
  unit Percent: display-radix=DECIMAL, physical-unit=%
  unit Milliamp: display-radix=DECIMAL, physical-unit=mA
  unit Millisecond: display-radix=DECIMAL, physical-unit=ms
