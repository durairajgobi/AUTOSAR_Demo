AUTOSAR XML (schema 4-3-1)
package /DoorControlSystem/Communication
  i pdu DoorCommand_PDU: tx-mode={i-pdu-port=1, timing-specification=event-controlled-timing={number-of-repetitions=0, timing-event-processing=CYCLIC}, transmission-mode-condition=transmission-mode-true-timing=event-controlled-timing={number-of-repetitions=0, timing-event-processing=CYCLIC}}, length=8
    signal DoorOpenCmd_Signal: start 0, 1 bit, little-endian, system signal DoorOpenCmd_SysSignal, i-signal-type=PRIMITIVE, init-value=0
    signal DoorCloseCmd_Signal: start 1, 1 bit, little-endian, system signal DoorCloseCmd_SysSignal, i-signal-type=PRIMITIVE, init-value=0
  i pdu DoorStatus_PDU: tx-mode={i-pdu-port=1, timing-specification=event-controlled-timing={number-of-repetitions=0, timing-event-processing=CYCLIC}}, length=8
    signal DoorPosition_Signal: start 0, 16 bit, little-endian, system signal DoorPosition_SysSignal, i-signal-type=PRIMITIVE, init-value=0
    signal DoorMotorCurrent_Signal: start 16, 16 bit, little-endian, system signal DoorMotorCurrent_SysSignal, i-signal-type=PRIMITIVE, init-value=0
    signal DoorStatus_Signal: start 32, 3 bit, little-endian, system signal DoorStatus_SysSignal, i-signal-type=PRIMITIVE, init-value=0
    signal DoorError_Signal: start 40, 8 bit, little-endian, system signal DoorError_SysSignal, i-signal-type=PRIMITIVE, init-value=0
  i pdu Diagnostics_PDU: length=8
    signal DiagService_Signal: start 0, 8 bit, little-endian, system signal DiagService_SysSignal, i-signal-type=PRIMITIVE, init-value=0
