AUTOSAR XML (schema 4-3-1)
package /DoorControlSystem/Diagnostics
  diag protocol UDS_Protocol: protocol-type=UDS
    uds-configuration:
      4 x uds service:
        ReadDID_Service: service-id=0x22, service-name=ReadDataByIdentifier, description=Read values of one or more DIDs, request-length=3, response-length=255
          6 x did element, all with access-permission=READ_ONLY:
            DoorStatus_DID: did-identifier=0xF190, did-data-length=2, update-period=100
              did data DoorPosition: data-type=uint16, byte-position=0
            DoorMotorCurrent_DID: did-identifier=0xF191, did-data-length=2, update-period=50
              did data MotorCurrent: data-type=uint16, byte-position=0, unit=mA
            DoorState_DID: did-identifier=0xF192, did-data-length=1, update-period=20
              did data State: data-type=uint8, byte-position=0
            DoorError_DID: did-identifier=0xF193, did-data-length=1, update-period=100
              did data ErrorCode: data-type=uint8, byte-position=0
            HardwareVersion_DID: did-identifier=0xF180, did-data-length=4, update-period=0
              did data Version: data-type=uint32, byte-position=0
            SoftwareVersion_DID: did-identifier=0xF181, did-data-length=4, update-period=0
              did data SWVersion: data-type=uint32, byte-position=0
        RoutineControl_Service: service-id=0x31, service-name=RoutineControl, description=Performs a routine identified by routine identifier, request-length=4, response-length=10
          routine control DoorSelfTest_Routine: routine-identifier=0x0001, routine-name=Door Self Test, routine-type=SELF_TEST, routine-description=Performs self-test of door mechanism, expected-duration=3000
            routine-options:
              option MotorTest: value=0x01, description=Test motor movement
              option SensorTest: value=0x02, description=Test position sensor
              option FullTest: value=0x03, description=Full system test
            result parameter TestResult: data-type=uint8, description=0=PASS, 1=FAIL
            result parameter ErrorCode: data-type=uint8, description=Error details if failed
          routine control DoorFullCycle_Routine: routine-identifier=0x0002, routine-name=Door Full Cycle, routine-type=MAINTENANCE, routine-description=Open and close door fully, expected-duration=5000
            result parameter CycleStatus: data-type=uint8, description=0=SUCCESS, 1=TIMEOUT, 2=JAMMED
          routine control CalibrateSensor_Routine: routine-identifier=0x0003, routine-name=Calibrate Position Sensor, routine-type=CALIBRATION, routine-description=Calibrate sensor 0-100%, expected-duration=2000
            result parameter CalibrationStatus: data-type=uint8
        ReadDTC_Service: service-id=0x19, service-name=ReadDTCInformation, description=Read Diagnostic Trouble Code information
          4 x sub function:
            ReportNumberOfDTC: sub-function-id=0x01
            ReportDTCByStatusMask: sub-function-id=0x02
            ReportDTCSnapshotRecord: sub-function-id=0x04
            ReportDTCExtendedRecord: sub-function-id=0x06
          5 x dtc definition:
            OvercurrentError: dtc-code=0xC10001, dtc-name=Motor Overcurrent, dtc-severity=ERROR, dtc-description=Motor current exceeds threshold
            TimeoutError: dtc-code=0xC10002, dtc-name=Door Movement Timeout, dtc-severity=ERROR, dtc-description=Door did not reach target position
            SensorError: dtc-code=0xC10003, dtc-name=Position Sensor Fault, dtc-severity=ERROR, dtc-description=Position sensor reading invalid
            MotorError: dtc-code=0xC10004, dtc-name=Motor Driver Fault, dtc-severity=ERROR, dtc-description=Motor driver communication error
            JAMError: dtc-code=0xC10005, dtc-name=Door Jam Detected, dtc-severity=WARNING, dtc-description=Door movement obstructed
        ClearDID_Service: service-id=0x14, service-name=ClearDiagnosticInformation, description=Clear diagnostic fault memory, request-length=4, response-length=2
          clear-memory-access:
            memory range FaultMemoryRange: start-address=0xC10001, end-address=0xC10005, clearable=true
package /DoorControlSystem/Diagnostics/DiagnosticDataElements
  data identifier set DoorSystem_DIDs
    6 x data identifier, all with read-only=true:
      DoorPosition_DataID: identifier=0xF190, data-type=DoorPositionType
      MotorCurrent_DataID: identifier=0xF191, data-type=CurrentType
      DoorState_DataID: identifier=0xF192, data-type=DoorStatusType
      DoorError_DataID: identifier=0xF193, data-type=DoorErrorType
      HardwareVersion_DataID: identifier=0xF180, data-type=DIDValueType
      SoftwareVersion_DataID: identifier=0xF181, data-type=DIDValueType
